## CMakeLists.txt
```
# SPDX-License-Identifier: Apache-2.0

cmake_minimum_required(VERSION 3.13.1)

find_package(Zephyr HINTS $ENV{ZEPHYR_BASE})
project(sparkfun_ublox_zephyr_library)

zephyr_compile_options(-fdiagnostics-color=always)

zephyr_include_directories(.)
target_sources(app PRIVATE src/SparkFun_Ublox_Zephyr_Library.cpp)
target_sources(app PRIVATE src/SparkFun_Ublox_Zephyr_Interface.cpp)

target_sources(app PRIVATE ${CMAKE_CURRENT_SOURCE_DIR}/src/main.c)
```

## prj.conf
```kconfig
#turn on c++ support
CONFIG_CPLUSPLUS=y

# turn on peripherals
CONFIG_GPIO=y
CONFIG_I2C=y
CONFIG_I2C_0=y
```

## nrf52840dk_nrf52840.overlay
```dts
&i2c0 {
	status = "okay";
	compatible = "nordic,nrf-twim";
};
```

## src/main.c
```c
/*
    Reading lat, long and UTC time via UBX binary commands
    By: Nathan Seidle
    SparkFun Electronics
    Date: August 22nd, 2018
    License: MIT. See license file for more information but you can
    basically do whatever you want with this code.

    This example reads the NMEA setences from the u-blox module over I2c and outputs
    them to the serial port

    Open the serial monitor at 115200 baud to see the output
    I2C clock speed: 100 kHz

    Ported to Zephyr by Vid Rajtmajer <vid@irnas.eu>, www.irnas.eu

    Development environment specifics: NCS v1.0.3 release

    To build: west build -b <BOARD_NAME> -p    Can also read NMEA sentences over I2C with check_ublox function
    To flash: west flash --erase
*/
#include <device.h>
#include <drivers/i2c.h>
#include <errno.h>
#include <zephyr.h>
#include <zephyr/types.h>

#include "SparkFun_Ublox_Zephyr_Interface.h"


#define I2C_DEV "I2C_0"

struct device *gpio_dev;
struct device *i2c_dev;
/* I2C pins used are defaults for I2C_0 on nrf52840
	SDA: 26
	SCL: 27
*/

uint8_t init_gpio(void) {
	const char* gpioName = "GPIO_0";
	gpio_dev = device_get_binding(gpioName);
	if (gpio_dev == NULL) {
		printk("Error: Could not get %s device\n", gpioName);
		return -EIO;
	}
    int err = set_gpio_dev(gpio_dev, true);     // set GPIO_0 device and enable debugging
    if (err) {
        return -EIO;
    }
    return 0;
}

uint8_t init_i2c(void) {
	i2c_dev = device_get_binding(I2C_DEV);
    if (!i2c_dev)
    {
        printk("I2C_0 error\n");
        return -1;
    }
    else
    {
        printk("I2C_0 Init OK\n");
        return 0;
    }
}

uint8_t init_gps(void) {
	if (gps_begin(i2c_dev) != 0)
  	{
    	printk("u-blox GPS init error!\n");
        return -1;
  	}
    return 0;
}


void main(void) {
	printk("Zephyr u-blox example\n");

	int err;
    err = init_gpio();
    if (err) {
        return;
    }
    err = init_i2c();
    if (err) {
        return;
    }

	err = init_gps();
    if (err) {
        return;
    }

	while(1) {
        //check_ublox(); // See if new data is available. Process bytes as they come in.
        get_position();
        get_datetime();
        k_msleep(250); // Don't pound too hard on the I2C bus
	}
}
```

## src/SparkFun_Ublox_Zephyr_Interface.cpp
```c
/*
    This is an interface that connects the CPP u-blox library with the main C code.
    Added to make it possible to run u-blox lib on Zephyr (NCS)

    This port was made by Vid Rajtmajer <vid@irnas.eu>, www.irnas.eu
*/
#include "SparkFun_Ublox_Zephyr_Interface.h"

#include <errno.h>
#include <stdio.h>
#include <string.h>
#include <time.h>

#include "SparkFun_Ublox_Zephyr_Library.h"


SFE_UBLOX_GPS myGPS; // driver class instance
long lastTime = 0;   // Simple local timer. Limits amount if I2C traffic to u-blox module.

// init GPIO checksumFailurePin and load GPIO device pointer to the driver
uint8_t set_gpio_dev(struct device *gpio_dev, uint8_t enable_debug)
{
    if (myGPS.init_gpio_pins(*gpio_dev) == false)
    {
        return -EIO;
    }
    // turn on debugging if enable_debug is set
    if (enable_debug)
    {
        myGPS.enableDebugging();
    }
    return 0;
}

// initialize I2C and check if GPS device respons
uint8_t gps_begin(struct device *i2c_dev)
{
    if (myGPS.begin(*i2c_dev) == false)
    {
        return -EIO;
    }
    return 0;
}

// This will pipe all NMEA sentences to UART so we can see them
void pipe_nmea_sentences(void)
{
    myGPS.setNMEAOutputPort();
}

// Check for available bytes from the device
void check_ublox(void)
{
    myGPS.checkUblox();
}

// Get position information when requested, also display number of satellites used in the fix
int get_position(void)
{
    //Query module only every second. Doing it more often will just cause I2C traffic.
    //The module only responds when a new position is available, print it to console
    if (k_uptime_get_32() - lastTime > 1000)
    {
        lastTime = k_uptime_get_32(); //Update the timer

        long latitude = myGPS.getLatitude();
        long longitude = myGPS.getLongitude();
        long altitude = myGPS.getAltitude();
        uint8_t SIV = myGPS.getSIV();

        printk("Position: Lat: %ld, Lon: %ld, Alt: %ld, SIV: %d", latitude, longitude, altitude, SIV);
        return 0;
    }
    return -EBUSY;
}

// Get date and time information when requested, check if they are valid and print info to console, it returns UNIX time
void get_datetime(void)
{
    int year = myGPS.getYear();
    int month = myGPS.getMonth();
    int day = myGPS.getDay();
    int hour = myGPS.getHour();
    int minute = myGPS.getMinute();
    int second = myGPS.getSecond();

    printk("DateTime: %d-%d-%d %d:%d:%d\n", year, month, day, hour, minute, second);

    printk("Time is ");
    if (myGPS.getTimeValid() == false)
    {
      printk("not ");
    }
    printk("valid. Date is ");
    if (myGPS.getDateValid() == false)
    {
      printk("not ");
    }
    printk("valid.\n");
}
```

## src/SparkFun_Ublox_Zephyr_Interface.h
```c
/*
    This is an interface that connects the CPP u-blox library with the main C code.
    Added to make it possible to run u-blox lib on Zephyr (NCS)

    This port was made by Vid Rajtmajer <vid@irnas.eu>, www.irnas.eu
*/
#include <time.h>
#include <zephyr.h>

#ifndef _UBLOX_LIB_INTERFACE_H_
#define _UBLOX_LIB_INTERFACE_H_

#ifdef __cplusplus
extern "C" {
#endif

    uint8_t set_gpio_dev(struct device *gpio_dev, uint8_t enable_debug); // init GPIO
    uint8_t gps_begin(struct device *i2c_dev);                           // initialize I2C and check if GPS device respons
    void pipe_nmea_sentences(void);                                      // print NMEA sentences

    void check_ublox(void);  // Check for available bytes from the device
    int get_position(void); // Get position information
    void get_datetime(void); // Get date and time information

#ifdef __cplusplus
}
#endif

#endif  //UBLOX_LIB_INTERFACE_H_
```
